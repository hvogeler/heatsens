## components/webprov/Kconfig
```kconfig
menu "Web Provisioning"

    config WEBPROV_PROJECT_NAME
        string "Project name"
        default "heatsens"
        help
            The name of this project. Used in various places such as
            the WiFi AP SSID during provisioning, logging, and display.

    config WEBPROV_AP_CHANNEL
        int "WiFi AP channel"
        default 1
        range 1 13
        help
            WiFi channel for the provisioning access point.

    config WEBPROV_AP_MAX_CONNECTIONS
        int "Max AP connections"
        default 4
        range 1 10
        help
            Maximum number of simultaneous connections to the provisioning AP.

endmenu
```

## sdkconfig.defaults
```kconfig
# Enable Bluetooth/BLE for WiFi provisioning using NimBLE stack
CONFIG_BT_ENABLED=y
CONFIG_BT_NIMBLE_ENABLED=y

# NimBLE settings optimized for provisioning
CONFIG_BT_NIMBLE_MAX_CONNECTIONS=1
CONFIG_BT_NIMBLE_ROLE_CENTRAL=n
CONFIG_BT_NIMBLE_ROLE_OBSERVER=n
CONFIG_BT_NIMBLE_ROLE_BROADCASTER=n
CONFIG_BT_NIMBLE_ROLE_PERIPHERAL=y

# WiFi Provisioning settings
CONFIG_WIFI_PROV_SCAN_MAX_ENTRIES=16
CONFIG_WIFI_PROV_AUTOSTOP_TIMEOUT=30
```
